## config/Manta/Kconfig.defconfig
```kconfig
/*
* Copyright (c) 2020 The ZMK Contributors
*
* SPDX-License-Identifier: MIT
*/

if SHIELD_MANTA

config ZMK_KEYBOARD_NAME
    default "Manta"

endif
```

## config/Manta/Kconfig.shield
```kconfig
/*
* Copyright (c) 2020 The ZMK Contributors
*
* SPDX-License-Identifier: MIT
*/

config SHIELD_MANTA
    def_bool $(shields_list_contains,Manta)
```
